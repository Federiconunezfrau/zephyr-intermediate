## twister-out/native_sim_native/host_gnu/zephyr-intermediate/tests/temp_alarm/homework.unit.temp_alarm/Kconfig/soc/Kconfig.tmp
```kconfig
# Load Zephyr SoC Kconfig descriptions.
osource "/home/federico/Documents/Zephyr_Intermediate_Course_IOMICO/taskworkspace/deps/zephyr/soc/xlnx/zynqmp/Kconfig"
osource "/home/federico/Documents/Zephyr_Intermediate_Course_IOMICO/taskworkspace/deps/zephyr/soc/xlnx/zynq7000/Kconfig"
osource "/home/federico/Documents/Zephyr_Intermediate_Course_IOMICO/taskworkspace/deps/zephyr/soc/xlnx/versalnet/Kconfig"
osource "/home/federico/Documents/Zephyr_Intermediate_Course_IOMICO/taskworkspace/deps/zephyr/soc/xlnx/versal2/Kconfig"
osource "/home/federico/Documents/Zephyr_Intermediate_Course_IOMICO/taskworkspace/deps/zephyr/soc/xlnx/versal/Kconfig"
osource "/home/federico/Documents/Zephyr_Intermediate_Course_IOMICO/taskworkspace/deps/zephyr/soc/xen/Kconfig"
osource "/home/federico/Documents/Zephyr_Intermediate_Course_IOMICO/taskworkspace/deps/zephyr/soc/wch/ch32v/Kconfig"
osource "/home/federico/Documents/Zephyr_Intermediate_Course_IOMICO/taskworkspace/deps/zephyr/soc/ti/simplelink/Kconfig"
osource "/home/federico/Documents/Zephyr_Intermediate_Course_IOMICO/taskworkspace/deps/zephyr/soc/ti/mspm0/Kconfig"
osource "/home/federico/Documents/Zephyr_Intermediate_Course_IOMICO/taskworkspace/deps/zephyr/soc/ti/lm3s6965/Kconfig"
osource "/home/federico/Documents/Zephyr_Intermediate_Course_IOMICO/taskworkspace/deps/zephyr/soc/ti/k3/Kconfig"
osource "/home/federico/Documents/Zephyr_Intermediate_Course_IOMICO/taskworkspace/deps/zephyr/soc/telink/tlsr/Kconfig"
osource "/home/federico/Documents/Zephyr_Intermediate_Course_IOMICO/taskworkspace/deps/zephyr/soc/syna/sr100/Kconfig"
osource "/home/federico/Documents/Zephyr_Intermediate_Course_IOMICO/taskworkspace/deps/zephyr/soc/starfive/jh71xx/Kconfig"
osource "/home/federico/Documents/Zephyr_Intermediate_Course_IOMICO/taskworkspace/deps/zephyr/soc/st/stm32/Kconfig"
osource "/home/federico/Documents/Zephyr_Intermediate_Course_IOMICO/taskworkspace/deps/zephyr/soc/snps/qemu_arc/Kconfig"
osource "/home/federico/Documents/Zephyr_Intermediate_Course_IOMICO/taskworkspace/deps/zephyr/soc/snps/nsim/arc_v/Kconfig"
osource "/home/federico/Documents/Zephyr_Intermediate_Course_IOMICO/taskworkspace/deps/zephyr/soc/snps/nsim/arc_classic/Kconfig"
osource "/home/federico/Documents/Zephyr_Intermediate_Course_IOMICO/taskworkspace/deps/zephyr/soc/snps/hsdk4xd/Kconfig"
osource "/home/federico/Documents/Zephyr_Intermediate_Course_IOMICO/taskworkspace/deps/zephyr/soc/snps/hsdk/Kconfig"
osource "/home/federico/Documents/Zephyr_Intermediate_Course_IOMICO/taskworkspace/deps/zephyr/soc/snps/emsk/Kconfig"
osource "/home/federico/Documents/Zephyr_Intermediate_Course_IOMICO/taskworkspace/deps/zephyr/soc/snps/emsdp/Kconfig"
osource "/home/federico/Documents/Zephyr_Intermediate_Course_IOMICO/taskworkspace/deps/zephyr/soc/snps/arc_iot/Kconfig"
osource "/home/federico/Documents/Zephyr_Intermediate_Course_IOMICO/taskworkspace/deps/zephyr/soc/silabs/Kconfig"
osource "/home/federico/Documents/Zephyr_Intermediate_Course_IOMICO/taskworkspace/deps/zephyr/soc/sifli/sf32/Kconfig"
osource "/home/federico/Documents/Zephyr_Intermediate_Course_IOMICO/taskworkspace/deps/zephyr/soc/sifive/sifive_freedom/Kconfig"
osource "/home/federico/Documents/Zephyr_Intermediate_Course_IOMICO/taskworkspace/deps/zephyr/soc/sensry/Kconfig"
osource "/home/federico/Documents/Zephyr_Intermediate_Course_IOMICO/taskworkspace/deps/zephyr/soc/rockchip/Kconfig"
osource "/home/federico/Documents/Zephyr_Intermediate_Course_IOMICO/taskworkspace/deps/zephyr/soc/renode/riscv_virtual/Kconfig"
osource "/home/federico/Documents/Zephyr_Intermediate_Course_IOMICO/taskworkspace/deps/zephyr/soc/renode/cortex_r8_virtual/Kconfig"
osource "/home/federico/Documents/Zephyr_Intermediate_Course_IOMICO/taskworkspace/deps/zephyr/soc/renesas/smartbond/Kconfig"
osource "/home/federico/Documents/Zephyr_Intermediate_Course_IOMICO/taskworkspace/deps/zephyr/soc/renesas/rz/Kconfig"
osource "/home/federico/Documents/Zephyr_Intermediate_Course_IOMICO/taskworkspace/deps/zephyr/soc/renesas/rx/Kconfig"
osource "/home/federico/Documents/Zephyr_Intermediate_Course_IOMICO/taskworkspace/deps/zephyr/soc/renesas/rcar/Kconfig"
osource "/home/federico/Documents/Zephyr_Intermediate_Course_IOMICO/taskworkspace/deps/zephyr/soc/renesas/ra/Kconfig"
osource "/home/federico/Documents/Zephyr_Intermediate_Course_IOMICO/taskworkspace/deps/zephyr/soc/realtek/fingerprint/Kconfig"
osource "/home/federico/Documents/Zephyr_Intermediate_Course_IOMICO/taskworkspace/deps/zephyr/soc/realtek/ec/Kconfig"
osource "/home/federico/Documents/Zephyr_Intermediate_Course_IOMICO/taskworkspace/deps/zephyr/soc/realtek/bee/Kconfig"
osource "/home/federico/Documents/Zephyr_Intermediate_Course_IOMICO/taskworkspace/deps/zephyr/soc/realtek/ameba/Kconfig"
osource "/home/federico/Documents/Zephyr_Intermediate_Course_IOMICO/taskworkspace/deps/zephyr/soc/raspberrypi/rpi_pico/Kconfig"
osource "/home/federico/Documents/Zephyr_Intermediate_Course_IOMICO/taskworkspace/deps/zephyr/soc/quicklogic/eos_s3/Kconfig"
osource "/home/federico/Documents/Zephyr_Intermediate_Course_IOMICO/taskworkspace/deps/zephyr/soc/qemu/virt_riscv/Kconfig"
osource "/home/federico/Documents/Zephyr_Intermediate_Course_IOMICO/taskworkspace/deps/zephyr/soc/qemu/or1k/Kconfig"
osource "/home/federico/Documents/Zephyr_Intermediate_Course_IOMICO/taskworkspace/deps/zephyr/soc/qemu/malta/Kconfig"
osource "/home/federico/Documents/Zephyr_Intermediate_Course_IOMICO/taskworkspace/deps/zephyr/soc/openisa/rv32m1/Kconfig"
osource "/home/federico/Documents/Zephyr_Intermediate_Course_IOMICO/taskworkspace/deps/zephyr/soc/openhwgroup/cva6/Kconfig"
osource "/home/federico/Documents/Zephyr_Intermediate_Course_IOMICO/taskworkspace/deps/zephyr/soc/oct/osd32mp15x/Kconfig"
osource "/home/federico/Documents/Zephyr_Intermediate_Course_IOMICO/taskworkspace/deps/zephyr/soc/nxp/s32/Kconfig"
osource "/home/federico/Documents/Zephyr_Intermediate_Course_IOMICO/taskworkspace/deps/zephyr/soc/nxp/rw/Kconfig"
osource "/home/federico/Documents/Zephyr_Intermediate_Course_IOMICO/taskworkspace/deps/zephyr/soc/nxp/mcx/Kconfig"
osource "/home/federico/Documents/Zephyr_Intermediate_Course_IOMICO/taskworkspace/deps/zephyr/soc/nxp/lpc/Kconfig"
osource "/home/federico/Documents/Zephyr_Intermediate_Course_IOMICO/taskworkspace/deps/zephyr/soc/nxp/layerscape/Kconfig"
osource "/home/federico/Documents/Zephyr_Intermediate_Course_IOMICO/taskworkspace/deps/zephyr/soc/nxp/kinetis/Kconfig"
osource "/home/federico/Documents/Zephyr_Intermediate_Course_IOMICO/taskworkspace/deps/zephyr/soc/nxp/imxrt/Kconfig"
osource "/home/federico/Documents/Zephyr_Intermediate_Course_IOMICO/taskworkspace/deps/zephyr/soc/nxp/imx/Kconfig"
osource "/home/federico/Documents/Zephyr_Intermediate_Course_IOMICO/taskworkspace/deps/zephyr/soc/nuvoton/numicro/Kconfig"
osource "/home/federico/Documents/Zephyr_Intermediate_Course_IOMICO/taskworkspace/deps/zephyr/soc/nuvoton/numaker/Kconfig"
osource "/home/federico/Documents/Zephyr_Intermediate_Course_IOMICO/taskworkspace/deps/zephyr/soc/nuvoton/npcx/Kconfig"
osource "/home/federico/Documents/Zephyr_Intermediate_Course_IOMICO/taskworkspace/deps/zephyr/soc/nuvoton/npcm/Kconfig"
osource "/home/federico/Documents/Zephyr_Intermediate_Course_IOMICO/taskworkspace/deps/zephyr/soc/nordic/Kconfig"
osource "/home/federico/Documents/Zephyr_Intermediate_Course_IOMICO/taskworkspace/deps/zephyr/soc/neorv32/Kconfig"
osource "/home/federico/Documents/Zephyr_Intermediate_Course_IOMICO/taskworkspace/deps/zephyr/soc/native/inf_clock/Kconfig"
osource "/home/federico/Documents/Zephyr_Intermediate_Course_IOMICO/taskworkspace/deps/zephyr/soc/microchip/sam/sama7/Kconfig"
osource "/home/federico/Documents/Zephyr_Intermediate_Course_IOMICO/taskworkspace/deps/zephyr/soc/microchip/sam/sam_d5x_e5x/Kconfig"
osource "/home/federico/Documents/Zephyr_Intermediate_Course_IOMICO/taskworkspace/deps/zephyr/soc/microchip/pic64/Kconfig"
osource "/home/federico/Documents/Zephyr_Intermediate_Course_IOMICO/taskworkspace/deps/zephyr/soc/microchip/pic32c/pic32cz_ca/Kconfig"
osource "/home/federico/Documents/Zephyr_Intermediate_Course_IOMICO/taskworkspace/deps/zephyr/soc/microchip/pic32c/pic32cx_sg/Kconfig"
osource "/home/federico/Documents/Zephyr_Intermediate_Course_IOMICO/taskworkspace/deps/zephyr/soc/microchip/pic32c/pic32cm_pl/Kconfig"
osource "/home/federico/Documents/Zephyr_Intermediate_Course_IOMICO/taskworkspace/deps/zephyr/soc/microchip/pic32c/pic32cm_jh/Kconfig"
osource "/home/federico/Documents/Zephyr_Intermediate_Course_IOMICO/taskworkspace/deps/zephyr/soc/microchip/miv/Kconfig"
osource "/home/federico/Documents/Zephyr_Intermediate_Course_IOMICO/taskworkspace/deps/zephyr/soc/microchip/mec/Kconfig"
osource "/home/federico/Documents/Zephyr_Intermediate_Course_IOMICO/taskworkspace/deps/zephyr/soc/mediatek/mt8xxx/Kconfig"
osource "/home/federico/Documents/Zephyr_Intermediate_Course_IOMICO/taskworkspace/deps/zephyr/soc/lowrisc/opentitan/Kconfig"
osource "/home/federico/Documents/Zephyr_Intermediate_Course_IOMICO/taskworkspace/deps/zephyr/soc/litex/litex_vexriscv/Kconfig"
osource "/home/federico/Documents/Zephyr_Intermediate_Course_IOMICO/taskworkspace/deps/zephyr/soc/ite/ec/Kconfig"
osource "/home/federico/Documents/Zephyr_Intermediate_Course_IOMICO/taskworkspace/deps/zephyr/soc/intel/wildcat_lake/Kconfig"
osource "/home/federico/Documents/Zephyr_Intermediate_Course_IOMICO/taskworkspace/deps/zephyr/soc/intel/raptor_lake/Kconfig"
osource "/home/federico/Documents/Zephyr_Intermediate_Course_IOMICO/taskworkspace/deps/zephyr/soc/intel/panther_lake/Kconfig"
osource "/home/federico/Documents/Zephyr_Intermediate_Course_IOMICO/taskworkspace/deps/zephyr/soc/intel/lakemont/Kconfig"
osource "/home/federico/Documents/Zephyr_Intermediate_Course_IOMICO/taskworkspace/deps/zephyr/soc/intel/intel_socfpga_std/Kconfig"
osource "/home/federico/Documents/Zephyr_Intermediate_Course_IOMICO/taskworkspace/deps/zephyr/soc/intel/intel_socfpga/Kconfig"
osource "/home/federico/Documents/Zephyr_Intermediate_Course_IOMICO/taskworkspace/deps/zephyr/soc/intel/intel_niosv/Kconfig"
osource "/home/federico/Documents/Zephyr_Intermediate_Course_IOMICO/taskworkspace/deps/zephyr/soc/intel/intel_ish/Kconfig"
osource "/home/federico/Documents/Zephyr_Intermediate_Course_IOMICO/taskworkspace/deps/zephyr/soc/intel/intel_adsp/Kconfig"
osource "/home/federico/Documents/Zephyr_Intermediate_Course_IOMICO/taskworkspace/deps/zephyr/soc/intel/elkhart_lake/Kconfig"
osource "/home/federico/Documents/Zephyr_Intermediate_Course_IOMICO/taskworkspace/deps/zephyr/soc/intel/atom/Kconfig"
osource "/home/federico/Documents/Zephyr_Intermediate_Course_IOMICO/taskworkspace/deps/zephyr/soc/intel/apollo_lake/Kconfig"
osource "/home/federico/Documents/Zephyr_Intermediate_Course_IOMICO/taskworkspace/deps/zephyr/soc/intel/alder_lake/Kconfig"
osource "/home/federico/Documents/Zephyr_Intermediate_Course_IOMICO/taskworkspace/deps/zephyr/soc/infineon/psoc4/Kconfig"
osource "/home/federico/Documents/Zephyr_Intermediate_Course_IOMICO/taskworkspace/deps/zephyr/soc/infineon/edge/Kconfig"
osource "/home/federico/Documents/Zephyr_Intermediate_Course_IOMICO/taskworkspace/deps/zephyr/soc/infineon/cat3/Kconfig"
osource "/home/federico/Documents/Zephyr_Intermediate_Course_IOMICO/taskworkspace/deps/zephyr/soc/infineon/cat1c/Kconfig"
osource "/home/federico/Documents/Zephyr_Intermediate_Course_IOMICO/taskworkspace/deps/zephyr/soc/infineon/cat1b/Kconfig"
osource "/home/federico/Documents/Zephyr_Intermediate_Course_IOMICO/taskworkspace/deps/zephyr/soc/infineon/cat1a/Kconfig"
osource "/home/federico/Documents/Zephyr_Intermediate_Course_IOMICO/taskworkspace/deps/zephyr/soc/gd/gd32/Kconfig"
osource "/home/federico/Documents/Zephyr_Intermediate_Course_IOMICO/taskworkspace/deps/zephyr/soc/gaisler/leon3/Kconfig"
osource "/home/federico/Documents/Zephyr_Intermediate_Course_IOMICO/taskworkspace/deps/zephyr/soc/gaisler/gr716a/Kconfig"
osource "/home/federico/Documents/Zephyr_Intermediate_Course_IOMICO/taskworkspace/deps/zephyr/soc/focaltech/Kconfig"
osource "/home/federico/Documents/Zephyr_Intermediate_Course_IOMICO/taskworkspace/deps/zephyr/soc/espressif/Kconfig"
osource "/home/federico/Documents/Zephyr_Intermediate_Course_IOMICO/taskworkspace/deps/zephyr/soc/ene/kb1200/Kconfig"
osource "/home/federico/Documents/Zephyr_Intermediate_Course_IOMICO/taskworkspace/deps/zephyr/soc/ene/kb106x/Kconfig"
osource "/home/federico/Documents/Zephyr_Intermediate_Course_IOMICO/taskworkspace/deps/zephyr/soc/elan/em32f967/Kconfig"
osource "/home/federico/Documents/Zephyr_Intermediate_Course_IOMICO/taskworkspace/deps/zephyr/soc/egis/Kconfig"
osource "/home/federico/Documents/Zephyr_Intermediate_Course_IOMICO/taskworkspace/deps/zephyr/soc/efinix/sapphire/Kconfig"
osource "/home/federico/Documents/Zephyr_Intermediate_Course_IOMICO/taskworkspace/deps/zephyr/soc/cdns/xtensa_sample_controller/Kconfig"
osource "/home/federico/Documents/Zephyr_Intermediate_Course_IOMICO/taskworkspace/deps/zephyr/soc/cdns/swerv/Kconfig"
osource "/home/federico/Documents/Zephyr_Intermediate_Course_IOMICO/taskworkspace/deps/zephyr/soc/cdns/sample_controller32/Kconfig"
osource "/home/federico/Documents/Zephyr_Intermediate_Course_IOMICO/taskworkspace/deps/zephyr/soc/cdns/dc233c/Kconfig"
osource "/home/federico/Documents/Zephyr_Intermediate_Course_IOMICO/taskworkspace/deps/zephyr/soc/brcm/bcmvk/Kconfig"
osource "/home/federico/Documents/Zephyr_Intermediate_Course_IOMICO/taskworkspace/deps/zephyr/soc/brcm/bcm2712/Kconfig"
osource "/home/federico/Documents/Zephyr_Intermediate_Course_IOMICO/taskworkspace/deps/zephyr/soc/brcm/bcm2711/Kconfig"
osource "/home/federico/Documents/Zephyr_Intermediate_Course_IOMICO/taskworkspace/deps/zephyr/soc/blackberry/qnxhv_vm/Kconfig"
osource "/home/federico/Documents/Zephyr_Intermediate_Course_IOMICO/taskworkspace/deps/zephyr/soc/bflb/Kconfig"
osource "/home/federico/Documents/Zephyr_Intermediate_Course_IOMICO/taskworkspace/deps/zephyr/soc/atmel/sam0/Kconfig"
osource "/home/federico/Documents/Zephyr_Intermediate_Course_IOMICO/taskworkspace/deps/zephyr/soc/atmel/sam/Kconfig"
osource "/home/federico/Documents/Zephyr_Intermediate_Course_IOMICO/taskworkspace/deps/zephyr/soc/aspeed/Kconfig"
osource "/home/federico/Documents/Zephyr_Intermediate_Course_IOMICO/taskworkspace/deps/zephyr/soc/arm/Kconfig"
osource "/home/federico/Documents/Zephyr_Intermediate_Course_IOMICO/taskworkspace/deps/zephyr/soc/arm/beetle/Kconfig"
osource "/home/federico/Documents/Zephyr_Intermediate_Course_IOMICO/taskworkspace/deps/zephyr/soc/antmicro/myra/Kconfig"
osource "/home/federico/Documents/Zephyr_Intermediate_Course_IOMICO/taskworkspace/deps/zephyr/soc/andestech/Kconfig"
osource "/home/federico/Documents/Zephyr_Intermediate_Course_IOMICO/taskworkspace/deps/zephyr/soc/amd/acp_6_0/Kconfig"
osource "/home/federico/Documents/Zephyr_Intermediate_Course_IOMICO/taskworkspace/deps/zephyr/soc/ambiq/Kconfig"
osource "/home/federico/Documents/Zephyr_Intermediate_Course_IOMICO/taskworkspace/deps/zephyr/soc/allwinner/sun8i_h3/Kconfig"
osource "/home/federico/Documents/Zephyr_Intermediate_Course_IOMICO/taskworkspace/deps/zephyr/soc/alif/ensemble/Kconfig"
osource "/home/federico/Documents/Zephyr_Intermediate_Course_IOMICO/taskworkspace/deps/zephyr/soc/aesc/Kconfig"
osource "/home/federico/Documents/Zephyr_Intermediate_Course_IOMICO/taskworkspace/deps/zephyr/soc/adi/max32/Kconfig"
```
